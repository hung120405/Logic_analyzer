## esp_firmware/sdkconfig.defaults
```kconfig
# WiFi Access Point
CONFIG_ESP_WIFI_SSID="PicoScope_WiFi"
CONFIG_ESP_WIFI_PASSWORD="picoscope123"
CONFIG_ESP_WIFI_AP_CHANNEL=6
CONFIG_ESP_WIFI_MAX_STA_CONN=4

# WebSocket buffer đủ lớn cho RLE data (200KB)
CONFIG_HTTPD_MAX_REQ_HDR_LEN=1024
CONFIG_HTTPD_MAX_URI_LEN=512
CONFIG_HTTPD_WS_MAX_FRAME_SIZE=204800

# SPIFFS
CONFIG_SPIFFS_MAX_PARTITIONS=1

# Bảng phân vùng tùy chỉnh
CONFIG_PARTITION_TABLE_CUSTOM=y
CONFIG_PARTITION_TABLE_CUSTOM_FILENAME="partitions.csv"
CONFIG_PARTITION_TABLE_OFFSET=0x8000

# FreeRTOS task stack lớn hơn (SPI + WebSocket cần nhiều stack)
CONFIG_ESP_MAIN_TASK_STACK_SIZE=8192

# Log level
CONFIG_LOG_DEFAULT_LEVEL_INFO=y
CONFIG_ESPTOOLPY_FLASHSIZE_4MB=y
CONFIG_HTTPD_WS_SUPPORT=y
```
